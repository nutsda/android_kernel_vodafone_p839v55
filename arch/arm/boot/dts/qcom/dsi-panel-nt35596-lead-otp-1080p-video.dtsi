/* Copyright (c) 2014, The Linux Foundation. All rights reserved.
 *
 * This program is free software; you can redistribute it and/or modify
 * it under the terms of the GNU General Public License version 2 and
 * only version 2 as published by the Free Software Foundation.
 *
 * This program is distributed in the hope that it will be useful,
 * but WITHOUT ANY WARRANTY; without even the implied warranty of
 * MERCHANTABILITY or FITNESS FOR A PARTICULAR PURPOSE.  See the
 * GNU General Public License for more details.
 */

&mdss_mdp {
	dsi_nt35596_lead_otp_1080p_video: qcom,mdss_dsi_nt35596_lead_otp_1080p_video {
		qcom,mdss-dsi-panel-name = "nt35596 lead otp 1080p video mode dsi panel";
		zte,lcd-proc-panel-name = "zteLEADOTP(nt35596+auo)_1080*1920-5.5Inch";
		qcom,cont-splash-enabled;
		qcom,mdss-dsi-panel-controller = <&mdss_dsi0>;
		qcom,mdss-dsi-panel-type = "dsi_video_mode";
		qcom,mdss-dsi-panel-destination = "display_1";
		qcom,mdss-dsi-panel-framerate = <60>;
		qcom,mdss-dsi-virtual-channel-id = <0>;
		qcom,mdss-dsi-stream = <0>;
		qcom,mdss-dsi-panel-width = <1080>;
		qcom,mdss-dsi-panel-height = <1920>;
		qcom,mdss-dsi-h-front-porch = <60>;
		qcom,mdss-dsi-h-back-porch = <30>;
		qcom,mdss-dsi-h-pulse-width = <5>;
		qcom,mdss-dsi-h-sync-skew = <0>;
		qcom,mdss-dsi-v-back-porch = <3>;
		qcom,mdss-dsi-v-front-porch = <4>;
		qcom,mdss-dsi-v-pulse-width = <3>;
		qcom,mdss-dsi-h-left-border = <0>;
		qcom,mdss-dsi-h-right-border = <0>;
		qcom,mdss-dsi-v-top-border = <0>;
		qcom,mdss-dsi-v-bottom-border = <0>;
		qcom,mdss-dsi-bpp = <24>;
		qcom,mdss-dsi-color-order = "rgb_swap_rgb";
		qcom,mdss-dsi-underflow-color = <0xff>;
		qcom,mdss-dsi-border-color = <0>;
		qcom,mdss-dsi-on-command = [
		29 01 00 00 00 00 02 FF EE
		29 01 00 00 00 00 02 FB 01
		29 01 00 00 0A 00 02 18 40
		29 01 00 00 14 00 02 18 00

		29 01 00 00 00 00 02 FF 04
		29 01 00 00 00 00 02 08 06
		29 01 00 00 00 00 02 FB 01

		//CMD2_P4           
		29 01 00 00 00 00 02 FF 05        
		29 01 00 00 00 00 02 C5 31  
		29 01 00 00 14 00 02 FB 01
		
        29 01 00 00 00 00 02 FF EE
		29 01 00 00 00 00 02 24 4F
		29 01 00 00 00 00 02 38 C8
		29 01 00 00 00 00 02 39 27
		29 01 00 00 00 00 02 1E 77
		29 01 00 00 00 00 02 1D 0F
		29 01 00 00 00 00 02 7E 71 
		29 01 00 00 00 00 02 7C 31 
		29 01 00 00 00 00 02 FB 01 
			 
		//CMD1           
		29 01 00 00 00 00 02 FF 00 
		29 01 00 00 00 00 02 D3 06
		29 01 00 00 00 00 02 D4 04
		29 01 00 00 00 00 02 35 00
		
		39 01 00 00 00 00 02 51 00 
    	       39 01 00 00 00 00 02 53 2C 
    	       39 01 00 00 00 00 02 55 01 
    	       
		29 01 00 00 78 00 02 11 00
		29 01 00 00 14 00 02 29 00];
		qcom,mdss-dsi-off-command = [05 01 00 00 32 00 02 28 00
					05 01 00 00 78 00 02 10 00];
		qcom,mdss-dsi-on-command-state = "dsi_lp_mode";
		qcom,mdss-dsi-off-command-state = "dsi_hs_mode";
		qcom,mdss-dsi-h-sync-pulse = <1>;
		qcom,mdss-dsi-traffic-mode = "burst_mode";
		qcom,mdss-dsi-bllp-eof-power-mode;
		qcom,mdss-dsi-bllp-power-mode;
		qcom,mdss-dsi-lane-0-state;
		qcom,mdss-dsi-lane-1-state;
		qcom,mdss-dsi-lane-2-state;
		qcom,mdss-dsi-lane-3-state;
		qcom,mdss-dsi-panel-timings = [D6 32 22 00 62 66 26 36 28 03 04 00];
		qcom,mdss-dsi-t-clk-post = <0x3>;
		qcom,mdss-dsi-t-clk-pre = <0x28>;
		qcom,mdss-dsi-bl-min-level = <1>;
		qcom,mdss-dsi-bl-max-level = <255>;
		qcom,mdss-dsi-dma-trigger = "trigger_sw";
		qcom,mdss-dsi-mdp-trigger = "none";
		qcom,mdss-dsi-bl-pmic-control-type = "bl_ctrl_dcs";
		qcom,mdss-dsi-reset-sequence = <1 5>, <0 5>, <1 5>, <0 5>, <1 20>;
		qcom,mdss-pan-physical-width-dimension = <68>;
		qcom,mdss-pan-physical-height-dimension = <121>;
	};
};
