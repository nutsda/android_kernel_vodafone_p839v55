/* Copyright (c) 2013-2014, The Linux Foundation. All rights reserved.
 *
 * This program is free software; you can redistribute it and/or modify
 * it under the terms of the GNU General Public License version 2 and
 * only version 2 as published by the Free Software Foundation.
 *
 * This program is distributed in the hope that it will be useful,
 * but WITHOUT ANY WARRANTY; without even the implied warranty of
 * MERCHANTABILITY or FITNESS FOR A PARTICULAR PURPOSE.  See the
 * GNU General Public License for more details.
 */

&mdss_mdp {
	dsi_r63315_tm_1080p_vid: qcom,mdss_dsi_r63315_tm_1080p_video {
		qcom,mdss-dsi-panel-name = "r63315 tm 1080p video mode dsi panel";
		zte,lcd-proc-panel-name = "ztetm(r63315+tm)_1080*1920-5.5Inch";
                qcom,cont-splash-enabled;
		qcom,mdss-dsi-panel-controller = <&mdss_dsi0>;
		qcom,mdss-dsi-panel-type = "dsi_video_mode";
		qcom,mdss-dsi-panel-destination = "display_1";
		qcom,mdss-dsi-panel-framerate = <60>;
		qcom,mdss-dsi-virtual-channel-id = <0>;
		qcom,mdss-dsi-stream = <0>;
		qcom,mdss-dsi-panel-width = <1080>;
		qcom,mdss-dsi-panel-height = <1920>;
		qcom,mdss-dsi-h-front-porch = <90>;
		qcom,mdss-dsi-h-back-porch = <40>;//_25
		qcom,mdss-dsi-h-pulse-width = <25>;//_16
		qcom,mdss-dsi-h-sync-skew = <0>;
		qcom,mdss-dsi-v-front-porch = <8>;
		qcom,mdss-dsi-v-back-porch = <6>;
		qcom,mdss-dsi-v-pulse-width = <2>; //_1
		qcom,mdss-dsi-h-left-border = <0>;
		qcom,mdss-dsi-h-right-border = <0>;
		qcom,mdss-dsi-v-top-border = <0>;
		qcom,mdss-dsi-v-bottom-border = <0>;
		qcom,mdss-dsi-bpp = <24>;
		qcom,mdss-dsi-color-order = "rgb_swap_rgb";
		qcom,mdss-dsi-underflow-color = <0xff>;
		qcom,mdss-dsi-border-color = <0>;
		qcom,mdss-dsi-on-command = [29 01 00 00 00 00 02 B0 04
			29 01 00 00 00 00 0B D0 11 85 BB 54 CF 4C 19 19 0C 00
			
			29 01 00 00 00 00 1A D3 1B 33 BB BB B3 33 33 33 00 01 00 A0 C8 A0 0D 75 75 33 3B 37 72 57 3D BF 33
			
			29 01 00 00 00 00 17 C4 70 00 00 22 22 22 22 22 22 01 03 00 00 00 22 22 22 22 22 22 01 03
			
			29 01 00 00 00 00 02 B0 00
			39 01 00 00 00 00 02 51 00 
	    	       39 01 00 00 00 00 02 53 2C 
	    	       39 01 00 00 00 00 02 55 01 	
	    	       
			05 01 00 00 0A 00 02 29 00
			05 01 00 00 78 00 02 11 00];
		qcom,mdss-dsi-off-command = [05 01 00 00 00 00 02 28 00
		    29 01 00 00 00 00 02 B0 04
			29 01 00 00 00 00 1A D3 13 33 BB B3 B3 33 33 33 00 01 00 A0 E8 A0 0D 46 46 33 3B 37 72 57 3D BF 33
			29 01 00 00 32 00 02 B0 00
			05 01 00 00 78 00 02 10 00
			29 01 00 00 00 00 02 B0 04
			29 01 00 00 00 00 02 B1 01];
		qcom,mdss-dsi-on-command-state = "dsi_lp_mode";
		qcom,mdss-dsi-off-command-state = "dsi_hs_mode";
		qcom,mdss-dsi-h-sync-pulse = <1>;
		qcom,mdss-dsi-traffic-mode = "burst_mode";
		qcom,mdss-dsi-bllp-eof-power-mode;
		qcom,mdss-dsi-bllp-power-mode;
		qcom,mdss-dsi-lane-0-state;
		qcom,mdss-dsi-lane-1-state;
		qcom,mdss-dsi-lane-2-state;
		qcom,mdss-dsi-lane-3-state;
		qcom,mdss-dsi-panel-timings = [E2 36 24 00 66 68 2A 38 2A 03 04 00];
		qcom,mdss-dsi-t-clk-post = <0x02>;
		qcom,mdss-dsi-t-clk-pre = <0x2A>;
		qcom,mdss-dsi-bl-min-level = <1>;
		qcom,mdss-dsi-bl-max-level = <255>;
		qcom,mdss-dsi-dma-trigger = "trigger_sw";
		qcom,mdss-dsi-mdp-trigger = "none";
		qcom,mdss-dsi-bl-pmic-control-type = "bl_ctrl_dcs";
		qcom,mdss-dsi-reset-sequence = <1 20>, <0 20>, <1 20>;
		qcom,mdss-pan-physical-width-dimension = <68>;
		qcom,mdss-pan-physical-height-dimension = <121>;
	};
};
