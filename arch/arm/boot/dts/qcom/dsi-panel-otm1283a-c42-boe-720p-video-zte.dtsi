/* Copyright (c) 2014, The Linux Foundation. All rights reserved.
 *
 * This program is free software; you can redistribute it and/or modify
 * it under the terms of the GNU General Public License version 2 and
 * only version 2 as published by the Free Software Foundation.
 *
 * This program is distributed in the hope that it will be useful,
 * but WITHOUT ANY WARRANTY; without even the implied warranty of
 * MERCHANTABILITY or FITNESS FOR A PARTICULAR PURPOSE.  See the
 * GNU General Public License for more details.
 */

/*---------------------------------------------------------------------------
 * This file is autogenerated file using gcdb parser. Please do not edit it.
 * Update input XML file to add a new entry or update variable in this file
 * VERSION = "1.0"
 *---------------------------------------------------------------------------*/
&mdss_mdp {
	dsi_otm1283a_c42_boe_720p_video: qcom,mdss_dsi_otm1283a_c42_boe_720p_video {
		qcom,mdss-dsi-panel-name = "otm1283a-c42 boe 720p video mode dsi panel";
		zfg,lcd-proc-panel-name = "zfgBOE(otm1283a-c42+boe)_720*1280-5.0Inch";
		zfg,lcd-product = <700>;
		qcom,cont-splash-enabled;
        qcom,mdss-dsi-panel-controller = <&mdss_dsi0>;
		qcom,mdss-dsi-panel-type = "dsi_video_mode";
		qcom,mdss-dsi-panel-destination = "display_1";
		qcom,mdss-dsi-panel-framerate = <60>;
		qcom,mdss-dsi-virtual-channel-id = <0>;
		qcom,mdss-dsi-stream = <0>;
		qcom,mdss-dsi-panel-width = <720>;
		qcom,mdss-dsi-panel-height = <1280>;
		qcom,mdss-dsi-h-front-porch = <158>;
		qcom,mdss-dsi-h-back-porch = <158>;
		qcom,mdss-dsi-h-pulse-width = <6>;
		qcom,mdss-dsi-h-sync-skew = <0>;
		qcom,mdss-dsi-v-back-porch = <16>;
		qcom,mdss-dsi-v-front-porch = <16>;
		qcom,mdss-dsi-v-pulse-width = <2>;
		qcom,mdss-dsi-h-left-border = <0>;
		qcom,mdss-dsi-h-right-border = <0>;
		qcom,mdss-dsi-v-top-border = <0>;
		qcom,mdss-dsi-v-bottom-border = <0>;
		qcom,mdss-dsi-bpp = <24>;
		qcom,mdss-dsi-color-order = "rgb_swap_rgb";
		qcom,mdss-dsi-underflow-color = <0xff>;
		qcom,mdss-dsi-border-color = <0>;
		qcom,mdss-dsi-on-command = [
		    29 01 00 00 00 00 02 00 00
			29 01 00 00 00 00 04 ff 12 83 01
			29 01 00 00 00 00 02 00 80
			29 01 00 00 00 00 03 ff 12 83
			29 01 00 00 00 00 02 00 92
			29 01 00 00 00 00 03 ff 30 02
			29 01 00 00 00 00 02 00 80
			29 01 00 00 00 00 0a C0 00 64 00 0F 11 00 64 0F 11
			
		//esd code by lxt
		29 01 00 00 00 00 02 00 80  		
		29 01 00 00 00 00 02 C4 01  		
		29 01 00 00 00 00 02 00 88  		
		29 01 00 00 00 00 02 C4 80  		
		29 01 00 00 00 00 02 00 C2  		
		29 01 00 00 00 00 02 F5 C0  		
		//esd end
		
			29 01 00 00 00 00 02 00  90
			29 01 00 00 00 00 07 C0 00 55 00 01 00 04
			29 01 00 00 00 00 02 00  a4
			29 01 00 00 00 00 02 c0  00
			29 01 00 00 00 00 02 00  b3
			29 01 00 00 00 00 03 C0 00 50
			29 01 00 00 00 00 02 00  81
			29 01 00 00 00 00 02 c1  66
			29 01 00 00 00 00 02 00  90
			29 01 00 00 00 00 02 C4 49
			29 01 00 00 00 00 02 00  90
			29 01 00 00 00 00 05 F5 02 11 02 11
			29 01 00 00 00 00 02 00 90
			29 01 00 00 00 00 02 C5 50
			29 01 00 00 00 00 02 00 94
			29 01 00 00 00 00 02 C5 66
			29 01 00 00 00 00 02 00 B2
			29 01 00 00 00 00 03 F5 00 00
			29 01 00 00 00 00 02 00 B4
			29 01 00 00 00 00 03 F5 00 00
			29 01 00 00 00 00 02 00 B6
			29 01 00 00 00 00 03 F5 00 00
			29 01 00 00 00 00 02 00 B8
			29 01 00 00 00 00 03 F5 00 00
			29 01 00 00 00 00 02 00 94
			29 01 00 00 00 00 02 F5 02
			29 01 00 00 00 00 02 00 BA
			29 01 00 00 00 00 02 F5 03
			29 01 00 00 00 00 02 00 B4
			29 01 00 00 00 00 02 C5 C0
			29 01 00 00 00 00 02 00 A0
			29 01 00 00 00 00 0f C4 05 10 06 02 05 15 10 05 10 07 02 05 15 10
			29 01 00 00 00 00 02 00 B0
			29 01 00 00 00 00 03 C4 00 00
			29 01 00 00 00 00 02 00 91
			29 01 00 00 00 00 03 C5 0c 60
			29 01 00 00 00 00 02 00  00
			29 01 00 00 00 00 03 D8 A5 A5
			29 01 00 00 00 00 02 00 B0
			29 01 00 00 00 00 03 C5 04 B8
			29 01 00 00 00 00 02 00 BB
			29 01 00 00 00 00 02 C5 80
			29 01 00 00 00 00 02 00 B2
			29 01 00 00 00 00 02 C5 40
			29 01 00 00 00 00 02 00 00
			29 01 00 00 00 00 02 D0 40
			29 01 00 00 00 00 02 00 00
			29 01 00 00 00 00 03 D1 00 00
			29 01 00 00 00 00 02 00 81
			29 01 00 00 00 00 03 C4 84 02
			29 01 00 00 00 00 02 00 C6
			29 01 00 00 00 00 02 B0 03
			29 01 00 00 00 00 02 00  00
			29 01 00 00 00 00 11 E1 0b 17 1c 0D 09 12 0C 0B 02 06 0A 07 0F 12 0D 00
			29 01 00 00 00 00 02 00 00
			29 01 00 00 00 00 11 E2 05 13 1a 0c 04 0e 0C 0B 02 06 0A 07 0F 12 0D 00
			29 01 00 00 00 00 02 00 80
			29 01 00 00 00 00 0c CB 00 00 00 00 00 00 00 00 00 00 00
			29 01 00 00 00 00 02 00 90
			29 01 00 00 00 00 10 CB 00 00 00 00 00 00 00 00 00 00 00 00 00 00 00
			29 01 00 00 00 00 02 00 A0
			29 01 00 00 00 00 10 CB 00 00 00 00 00 00 00 00 00 00 00 00 00 00 00
			29 01 00 00 00 00 02 00 B0
			29 01 00 00 00 00 10 CB 00 00 00 00 00 00 00 00 00 00 00 00 00 00 00
			29 01 00 00 00 00 02 00 C0
			29 01 00 00 00 00 10 CB 05 05 05 05 05 05 00 00 00 00 00 00 00 00 00
			29 01 00 00 00 00 02 00 D0
			29 01 00 00 00 00 10 CB 00 00 00 00 00 05 05 05 05 05 05 05 05 00 00
			29 01 00 00 00 00 02 00 E0
			29 01 00 00 00 00 0f CB 00 00 00 00 00 00 00 00 00 00 00 00 05 05
			29 01 00 00 00 00 02 00 F0
			29 01 00 00 00 00 0c CB FF FF FF FF FF FF FF FF FF FF FF
			29 01 00 00 00 00 02 00 80
			29 01 00 00 00 00 10 CC 09 0B 0D 0F 01 03 00 00 00 00 00 00 00 00 00
			29 01 00 00 00 00 02 00 90
			29 01 00 00 00 00 10 CC 00 00 00 00 00 2E 2D 0A 0C 0E 10 02 04 00 00
			29 01 00 00 00 00 02 00 A0
			29 01 00 00 00 00 0f CC 00 00 00 00 00 00 00 00 00 00 00 00 2E 2D
			29 01 00 00 00 00 02 00 B0
			29 01 00 00 00 00 10 CC 10 0E 0C 0A 04 02 00 00 00 00 00 00 00 00 00
			29 01 00 00 00 00 02 00 C0
			29 01 00 00 00 00 10 CC 00 00 00 00 00 2D 2E 0F 0D 0B 09 03 01 00 00
			29 01 00 00 00 00 02 00 D0
			29 01 00 00 00 00 0f CC 00 00 00 00 00 00 00 00 00 00 00 00 2D 2E
			29 01 00 00 00 00 02 00 80
			29 01 00 00 00 00 0d CE 8B 03 00 8A 03 00 89 03 00 88 03 00
			29 01 00 00 00 00 02 00 90
			29 01 00 00 00 00 0F CE 00 00 00 00 00 00 00 00 00 00 00 00 00 00
			29 01 00 00 00 00 02 00 A0
			29 01 00 00 00 00 0F CE 38 07 84 FC 8B 00 0c 38 06 84 FD 8B 00 0c
			29 01 00 00 00 00 02 00 B0
			29 01 00 00 00 00 0F CE 38 05 84 FE 8B 00 0c 38 04 84 FF 8B 00 0c
			29 01 00 00 00 00 02 00 C0
			29 01 00 00 00 00 0F CE 38 03 85 00 8B 00 0c 38 02 85 01 8B 00 0c
			29 01 00 00 00 00 02 00 D0
			29 01 00 00 00 00 0F CE 38 01 85 02 8B 00 0c 38 00 85 03 8B 00 0c
			29 01 00 00 00 00 02 00 80
			29 01 00 00 00 00 0F CF 00 00 00 00 00 00 00 00 00 00 00 00 00 00
			29 01 00 00 00 00 02 00 90
			29 01 00 00 00 00 0F CF 00 00 00 00 00 00 00 00 00 00 00 00 00 00
			29 01 00 00 00 00 02 00 A0
			29 01 00 00 00 00 0F CF 00 00 00 00 00 00 00 00 00 00 00 00 00 00
			29 01 00 00 00 00 02 00 B0
			29 01 00 00 00 00 0f CF 00 00 00 00 00 00 00 00 00 00 00 00 00 00
			29 01 00 00 00 00 02 00 C0
			29 01 00 00 00 00 0c CF 01 01 20 20 00 00 01 01 00 02 02
			29 01 00 00 00 00 02 00 B5
			29 01 00 00 00 00 07 C5 33 F1 FF 33 F1 FF
			29 01 00 00 00 00 02 00 87
			29 01 00 00 00 00 02 C4 08
			29 01 00 00 00 00 02 00 89
			29 01 00 00 00 00 02 C4 08
			
			29 01 00 00 00 00 02 00 90
			29 01 00 00 00 00 02 D6 00
			29 01 00 00 00 00 02 00 A0
			29 01 00 00 00 00 0d D6 01 1A 01 1A 01 E6 01 B3 01 B3 01 B3
			29 01 00 00 00 00 02 00 B0
			29 01 00 00 00 00 0d D6 01 B3 01 CD 01 CD 01 CD 01 CD 01 66
			29 01 00 00 00 00 02 00 C0
			29 01 00 00 00 00 0d D6 66 11 11 9A 11 77 77 11 77 77 11 89
			
			29 01 00 00 00 00 02 00 D0
			29 01 00 00 00 00 07 D6 89 11 89 89 11 44
			29 01 00 00 00 00 02 00 E0
			39 01 00 00 00 00 0d D6 33 11 44 4D 11 3C 3C 11 3C 3C 11 44			
	
			29 01 00 00 00 00 02 00 F0
			29 01 00 00 00 00 07 D6 44 11 44 44 11 22
			29 01 00 00 00 00 02 00 00
			29 01 00 00 00 00 04 FF FF FF FF
			29 01 00 00 00 00 02 00 00
			29 01 00 00 00 00 02 36 00
			39 01 00 00 00 00 02 35 00
			29 01 00 00 00 00 02 00 00
			
			29 01 00 00 00 00 02 55 00	
			
			39 01 00 00 00 00 02 51  00 
	    	39 01 00 00 00 00 02 53  24 
	    	39 01 00 00 00 00 02 55  01 	
			
			05 01 00 00 96 00 02 11 00 
            05 01 00 00 32 00 02 29 00 
		];
		qcom,mdss-dsi-off-command = [05 01 00 00 00 00 02 28 00
					05 01 00 00 78 00 02 10 00];
		qcom,mdss-dsi-on-command-state = "dsi_lp_mode";
		qcom,mdss-dsi-off-command-state = "dsi_hs_mode";
		//qcom,esd-check-enabled;
		//qcom,mdss-dsi-panel-status-check-mode = "bta_check";
		qcom,mdss-dsi-panel-status-command = [06 01 00 01 05 00 02 0E 08];
		qcom,mdss-dsi-panel-status-command-state = "dsi_lp_mode";
		qcom,mdss-dsi-panel-status-check-mode = "reg_read";
		qcom,mdss-dsi-panel-status-value = <0x80>;
		qcom,mdss-dsi-h-sync-pulse = <1>;
		qcom,mdss-dsi-traffic-mode = "burst_mode";
		qcom,mdss-dsi-lane-map = "lane_map_0123";
		qcom,mdss-dsi-bllp-eof-power-mode;
		qcom,mdss-dsi-bllp-power-mode;
		qcom,mdss-dsi-lane-0-state;
		qcom,mdss-dsi-lane-1-state;
		qcom,mdss-dsi-lane-2-state;
		qcom,mdss-dsi-lane-3-state;
		qcom,mdss-dsi-panel-timings = [92 1A 12 00 3E 42 16 1E 14 03 04 00];
		qcom,mdss-dsi-t-clk-post = <0x22>;
		qcom,mdss-dsi-t-clk-pre = <0x3d>;
		qcom,mdss-dsi-bl-min-level = <1>;
		qcom,mdss-dsi-bl-max-level = <255>;
		qcom,mdss-dsi-dma-trigger = <0x04>;
		qcom,mdss-dsi-mdp-trigger = <0x0>;
		qcom,mdss-dsi-bl-pmic-control-type = "bl_ctrl_dcs";
		/*qcom,mdss-dsi-bl-cmd-gpio = <&msmgpio 34 0>;*/
		qcom,mdss-dsi-reset-sequence = <1 20>, <0 10>, <1 120>;
		qcom,mdss-pan-physical-width-dimension = <64>;
		qcom,mdss-pan-physical-height-dimension = <113>;
	};
};
