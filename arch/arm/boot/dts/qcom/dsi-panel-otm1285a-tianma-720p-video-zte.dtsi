/* Copyright (c) 2014, The Linux Foundation. All rights reserved.
 *
 * This program is free software; you can redistribute it and/or modify
 * it under the terms of the GNU General Public License version 2 and
 * only version 2 as published by the Free Software Foundation.
 *
 * This program is distributed in the hope that it will be useful,
 * but WITHOUT ANY WARRANTY; without even the implied warranty of
 * MERCHANTABILITY or FITNESS FOR A PARTICULAR PURPOSE.  See the
 * GNU General Public License for more details.
 */

/*---------------------------------------------------------------------------
 * This file is autogenerated file using gcdb parser. Please do not edit it.
 * Update input XML file to add a new entry or update variable in this file
 * VERSION = "1.0"
 *---------------------------------------------------------------------------*/
&mdss_mdp {
	dsi_otm1285a_tianma_720p_video: qcom,mdss_dsi_otm1285a_tianma_720p_video {
		qcom,mdss-dsi-panel-name = "otm1285a tianma 720p video mode dsi panel";
		zte,lcd-proc-panel-name = "zteTIANMA(otm1285a+tianma)_720*1280-5.0Inch";
		zte,lcd-product = <801>;
		qcom,cont-splash-enabled;
        qcom,mdss-dsi-panel-controller = <&mdss_dsi0>;
		qcom,mdss-dsi-panel-type = "dsi_video_mode";
		qcom,mdss-dsi-panel-destination = "display_1";
		qcom,mdss-dsi-panel-framerate = <60>;
		qcom,mdss-dsi-virtual-channel-id = <0>;
		qcom,mdss-dsi-stream = <0>;
		qcom,mdss-dsi-panel-width = <720>;
		qcom,mdss-dsi-panel-height = <1280>;
		qcom,mdss-dsi-h-front-porch = <168>;
		qcom,mdss-dsi-h-back-porch = <168>;
		qcom,mdss-dsi-h-pulse-width = <6>;
		qcom,mdss-dsi-h-sync-skew = <0>;
		qcom,mdss-dsi-v-back-porch = <16>;
		qcom,mdss-dsi-v-front-porch = <16>;
		qcom,mdss-dsi-v-pulse-width = <2>;
		qcom,mdss-dsi-h-left-border = <0>;
		qcom,mdss-dsi-h-right-border = <0>;
		qcom,mdss-dsi-v-top-border = <0>;
		qcom,mdss-dsi-v-bottom-border = <0>;
		qcom,mdss-dsi-bpp = <24>;
		qcom,mdss-dsi-color-order = "rgb_swap_rgb";
		qcom,mdss-dsi-underflow-color = <0xff>;
		qcom,mdss-dsi-border-color = <0>;
		qcom,mdss-dsi-on-command = [
		    39  01  00  00  00  00  02  00  00 
            39  01  00  00  00  00  04  FF  12  85  01 
            39  01  00  00  00  00  02  00  80 
            39  01  00  00  00  00  03  FF  12  85  

            39  01  00  00  00  00  02  00  A3 
            39  01  00  00  00  00  02  B6  03

            39  01  00  00  00  00  02  00  00 
            39  01  00  00  00  00  02  59  00
			
			//pwm 22.78khz
			39  01  00  00  00  00  02  00  b0 
            39  01  00  00  00  00  02  ca  02

            39  01  00  00  00  00  02  00  b3 
            39  01  00  00  00  00  02  ca  40
            //end
			
            39  01  00  00  00  00  02  00  A0 
            39  01  00  00  00  00  0D  D6  02  01  00  00  00  00  00  00  00  00  00  00	

            39  01  00  00  00  00  02  00  B0 
            39  01  00  00  00  00  0D  D6  00  00  5A  B3  B3  B3  B3  B3  B3  B3  B3  B3	

            39  01  00  00  00  00  02  00  C0 
            39  01  00  00  00  00  0D  D6  3C  00  77  77  77  77  77  77  77  77  77  77	

            39  01  00  00  00  00  02  00  D0 
            39  01  00  00  00  00  0D  D6  3C  3C  3C  3C  3C  3C  3C  3C  3C  3C  3C  3C	
			
			39 01 00 00 00 00 02 51  00 
	    	39 01 00 00 00 00 02 53  2c 
	    	39 01 00 00 00 00 02 55  81 	
			
			05 01 00 00 78 00 02 11 00 
            05 01 00 00 00 00 02 29 00 
		];
		qcom,mdss-dsi-off-command = [05 01 00 00 00 00 02 28 00
					05 01 00 00 78 00 02 10 00];
		qcom,mdss-dsi-on-command-state = "dsi_lp_mode";
		qcom,mdss-dsi-off-command-state = "dsi_hs_mode";
		//qcom,esd-check-enabled;
		//qcom,mdss-dsi-panel-status-check-mode = "bta_check";
		//qcom,mdss-dsi-panel-status-command = [06 01 00 01 05 00 02 0E 08];
		//qcom,mdss-dsi-panel-status-command-state = "dsi_lp_mode";
		//qcom,mdss-dsi-panel-status-check-mode = "reg_read";
		//qcom,mdss-dsi-panel-status-value = <0x80>;
		qcom,mdss-dsi-h-sync-pulse = <1>;
		qcom,mdss-dsi-traffic-mode = "non_burst_sync_event";
		qcom,mdss-dsi-lane-map = "lane_map_0123";
		qcom,mdss-dsi-bllp-eof-power-mode;
		qcom,mdss-dsi-bllp-power-mode;
		qcom,mdss-dsi-lane-0-state;
		qcom,mdss-dsi-lane-1-state;
		qcom,mdss-dsi-lane-2-state;
		qcom,mdss-dsi-lane-3-state;
		qcom,mdss-dsi-panel-timings = [7c 20 14 00 46 48 1a 22 18 03 04 00];
		qcom,mdss-dsi-t-clk-post = <0x04>;
		qcom,mdss-dsi-t-clk-pre = <0x27>;
		qcom,mdss-dsi-bl-min-level = <1>;
		qcom,mdss-dsi-bl-max-level = <255>;
		qcom,mdss-dsi-dma-trigger = <0x04>;
		qcom,mdss-dsi-mdp-trigger = <0x0>;
		qcom,mdss-dsi-bl-pmic-control-type = "bl_ctrl_dcs";
		/*qcom,mdss-dsi-bl-cmd-gpio = <&msmgpio 34 0>;*/
		qcom,mdss-dsi-reset-sequence = <1 20>, <0 20>, <1 20>;
		qcom,mdss-pan-physical-width-dimension = <64>;
		qcom,mdss-pan-physical-height-dimension = <113>;
	};
};
