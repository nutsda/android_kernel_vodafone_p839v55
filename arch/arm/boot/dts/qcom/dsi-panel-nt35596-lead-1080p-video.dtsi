/* Copyright (c) 2014, The Linux Foundation. All rights reserved.
 *
 * This program is free software; you can redistribute it and/or modify
 * it under the terms of the GNU General Public License version 2 and
 * only version 2 as published by the Free Software Foundation.
 *
 * This program is distributed in the hope that it will be useful,
 * but WITHOUT ANY WARRANTY; without even the implied warranty of
 * MERCHANTABILITY or FITNESS FOR A PARTICULAR PURPOSE.  See the
 * GNU General Public License for more details.
 */

&mdss_mdp {
	dsi_nt35596_lead_1080p_video: qcom,mdss_dsi_nt35596_lead_1080p_video {
		qcom,mdss-dsi-panel-name = "nt35596 lead 1080p video mode dsi panel";
		zfg,lcd-proc-panel-name = "zfgLEAD(nt35596+auo)_1080*1920-5.5Inch";
		qcom,cont-splash-enabled;
		qcom,mdss-dsi-panel-controller = <&mdss_dsi0>;
		qcom,mdss-dsi-panel-type = "dsi_video_mode";
		qcom,mdss-dsi-panel-destination = "display_1";
		qcom,mdss-dsi-panel-framerate = <60>;
		qcom,mdss-dsi-virtual-channel-id = <0>;
		qcom,mdss-dsi-stream = <0>;
		qcom,mdss-dsi-panel-width = <1080>;
		qcom,mdss-dsi-panel-height = <1920>;
		qcom,mdss-dsi-h-front-porch = <60>;
		qcom,mdss-dsi-h-back-porch = <30>;
		qcom,mdss-dsi-h-pulse-width = <5>;
		qcom,mdss-dsi-h-sync-skew = <0>;
		qcom,mdss-dsi-v-back-porch = <3>;
		qcom,mdss-dsi-v-front-porch = <4>;
		qcom,mdss-dsi-v-pulse-width = <3>;
		qcom,mdss-dsi-h-left-border = <0>;
		qcom,mdss-dsi-h-right-border = <0>;
		qcom,mdss-dsi-v-top-border = <0>;
		qcom,mdss-dsi-v-bottom-border = <0>;
		qcom,mdss-dsi-bpp = <24>;
		qcom,mdss-dsi-color-order = "rgb_swap_rgb";
		qcom,mdss-dsi-underflow-color = <0xff>;
		qcom,mdss-dsi-border-color = <0>;
		qcom,mdss-dsi-on-command = [
		29 01 00 00 00 00 02 FF EE
		29 01 00 00 00 00 02 FB 01
		29 01 00 00 0A 00 02 18 40
		29 01 00 00 14 00 02 18 00

		29 01 00 00 00 00 02 FF 04
		29 01 00 00 00 00 02 08 06
		29 01 00 00 00 00 02 FB 01
		
		29 01 00 00 00 00 02 FF 05
		29 01 00 00 00 00 02 C5 31
		29 01 00 00 14 00 02 FB 01
        29 01 00 00 00 00 02 FF EE
		29 01 00 00 00 00 02 24 4F
		29 01 00 00 00 00 02 38 C8
		29 01 00 00 00 00 02 39 27
		29 01 00 00 00 00 02 1E 77
		29 01 00 00 00 00 02 1D 0F
		29 01 00 00 00 00 02 7E 71 
		29 01 00 00 00 00 02 7C 31 
		29 01 00 00 00 00 02 FB 01 

		//CMD2_P0           
		29 01 00 00 00 00 02 FF 01        
		29 01 00 00 00 00 02 00 01
		29 01 00 00 00 00 02 01 55
		29 01 00 00 00 00 02 02 40		            
		29 01 00 00 00 00 02 05 50
		29 01 00 00 00 00 02 06 4A
		29 01 00 00 00 00 02 07 29
		29 01 00 00 00 00 02 08 0C
		29 01 00 00 00 00 02 0B 87
		29 01 00 00 00 00 02 0C 87
		29 01 00 00 00 00 02 0E B0
		29 01 00 00 00 00 02 0F B3
		29 01 00 00 00 00 02 11 10
		29 01 00 00 00 00 02 12 10
		29 01 00 00 00 00 02 13 03
		29 01 00 00 00 00 02 14 4A
		29 01 00 00 00 00 02 15 12
		29 01 00 00 00 00 02 16 12		            
		29 01 00 00 00 00 02 18 00
		29 01 00 00 00 00 02 19 77
		29 01 00 00 00 00 02 1A 55
		29 01 00 00 00 00 02 1B 13
		29 01 00 00 00 00 02 1C 00
		29 01 00 00 00 00 02 1D 00		            
		29 01 00 00 00 00 02 1E 00
		29 01 00 00 00 00 02 1F 00		                        
		29 01 00 00 00 00 02 58 82      
		29 01 00 00 00 00 02 59 02      
		29 01 00 00 00 00 02 5A 02      
		29 01 00 00 00 00 02 5B 02      
		29 01 00 00 00 00 02 5C 82      
		29 01 00 00 00 00 02 5D 82      
		29 01 00 00 00 00 02 5E 02      
		29 01 00 00 00 00 02 5F 02
		29 01 00 00 00 00 02 72 31       
		29 01 00 00 00 00 02 FB 01      

		//CMD2_P4           
		29 01 00 00 00 00 02 FF 05        
		29 01 00 00 00 00 02 00 01
		29 01 00 00 00 00 02 01 0B
		29 01 00 00 00 00 02 02 0C
		29 01 00 00 00 00 02 03 09
		29 01 00 00 00 00 02 04 0A
		29 01 00 00 00 00 02 05 00
		29 01 00 00 00 00 02 06 0F
		29 01 00 00 00 00 02 07 10
		29 01 00 00 00 00 02 08 00
		29 01 00 00 00 00 02 09 00
		29 01 00 00 00 00 02 0A 00
		29 01 00 00 00 00 02 0B 00
		29 01 00 00 00 00 02 0C 00
		29 01 00 00 00 00 02 0D 13
		29 01 00 00 00 00 02 0E 15
		29 01 00 00 00 00 02 0F 17
		29 01 00 00 00 00 02 10 01
		29 01 00 00 00 00 02 11 0B
		29 01 00 00 00 00 02 12 0C
		29 01 00 00 00 00 02 13 09
		29 01 00 00 00 00 02 14 0A
		29 01 00 00 00 00 02 15 00
		29 01 00 00 00 00 02 16 0F
		29 01 00 00 00 00 02 17 10
		29 01 00 00 00 00 02 18 00
		29 01 00 00 00 00 02 19 00
		29 01 00 00 00 00 02 1A 00
		29 01 00 00 00 00 02 1B 00
		29 01 00 00 00 00 02 1C 00
		29 01 00 00 00 00 02 1D 13
		29 01 00 00 00 00 02 1E 15
		29 01 00 00 00 00 02 1F 17         
		29 01 00 00 00 00 02 20 00
		29 01 00 00 00 00 02 21 03
		29 01 00 00 00 00 02 22 01
		29 01 00 00 00 00 02 23 40
		29 01 00 00 00 00 02 24 40
		29 01 00 00 00 00 02 25 ED          
		29 01 00 00 00 00 02 29 58
		29 01 00 00 00 00 02 2A 12
		29 01 00 00 00 00 02 2B 01
		29 01 00 00 00 00 02 4B 04
		29 01 00 00 00 00 02 4C 12
		29 01 00 00 00 00 02 4D 02
		29 01 00 00 00 00 02 4E 20
		29 01 00 00 00 00 02 4F 20
		29 01 00 00 00 00 02 50 02
		29 01 00 00 00 00 02 51 61
		29 01 00 00 00 00 02 52 01
		29 01 00 00 00 00 02 53 63
		29 01 00 00 00 00 02 54 75
		29 01 00 00 00 00 02 55 ED        
		29 01 00 00 00 00 02 5B 00
		29 01 00 00 00 00 02 5C 00
		29 01 00 00 00 00 02 5F 15
		29 01 00 00 00 00 02 60 75
		29 01 00 00 00 00 02 63 00
		29 01 00 00 00 00 02 64 00
		29 01 00 00 00 00 02 67 00
		29 01 00 00 00 00 02 68 04
		29 01 00 00 00 00 02 6C 40    
		29 01 00 00 00 00 02 7A 80            
		29 01 00 00 00 00 02 7B A3           
		29 01 00 00 00 00 02 7C D8            
		29 01 00 00 00 00 02 7D 60
		29 01 00 00 00 00 02 7F 15
		29 01 00 00 00 00 02 80 00            
		29 01 00 00 00 00 02 83 00           
		29 01 00 00 00 00 02 93 08
		29 01 00 00 00 00 02 94 0A 
		29 01 00 00 00 00 02 8A 00
		29 01 00 00 00 00 02 9B 0F
		29 01 00 00 00 00 02 FB 01

		//Gamma
		29 01 00 00 00 00 02 FF 01
		29 01 00 00 00 00 02 75 00
		29 01 00 00 00 00 02 76 18
		29 01 00 00 00 00 02 77 00
		29 01 00 00 00 00 02 78 38
		29 01 00 00 00 00 02 79 00
		29 01 00 00 00 00 02 7A 65
		29 01 00 00 00 00 02 7B 00
		29 01 00 00 00 00 02 7C 84
		29 01 00 00 00 00 02 7D 00
		29 01 00 00 00 00 02 7E 9B
		29 01 00 00 00 00 02 7F 00
		29 01 00 00 00 00 02 80 AF
		29 01 00 00 00 00 02 81 00
		29 01 00 00 00 00 02 82 C1
		29 01 00 00 00 00 02 83 00
		29 01 00 00 00 00 02 84 D2
		29 01 00 00 00 00 02 85 00
		29 01 00 00 00 00 02 86 DF
		29 01 00 00 00 00 02 87 01
		29 01 00 00 00 00 02 88 11
		29 01 00 00 00 00 02 89 01
		29 01 00 00 00 00 02 8A 38
		29 01 00 00 00 00 02 8B 01
		29 01 00 00 00 00 02 8C 76
		29 01 00 00 00 00 02 8D 01
		29 01 00 00 00 00 02 8E A7
		29 01 00 00 00 00 02 8F 01
		29 01 00 00 00 00 02 90 F3
		29 01 00 00 00 00 02 91 02
		29 01 00 00 00 00 02 92 2F
		29 01 00 00 00 00 02 93 02
		29 01 00 00 00 00 02 94 30
		29 01 00 00 00 00 02 95 02
		29 01 00 00 00 00 02 96 66
		29 01 00 00 00 00 02 97 02
		29 01 00 00 00 00 02 98 A0
		29 01 00 00 00 00 02 99 02
		29 01 00 00 00 00 02 9A C5
		29 01 00 00 00 00 02 9B 02
		29 01 00 00 00 00 02 9C F8
		29 01 00 00 00 00 02 9D 03
		29 01 00 00 00 00 02 9E 1B
		29 01 00 00 00 00 02 9F 03
		29 01 00 00 00 00 02 A0 46
		29 01 00 00 00 00 02 A2 03
		29 01 00 00 00 00 02 A3 52
		29 01 00 00 00 00 02 A4 03
		29 01 00 00 00 00 02 A5 62
		29 01 00 00 00 00 02 A6 03
		29 01 00 00 00 00 02 A7 71
		29 01 00 00 00 00 02 A9 03
		29 01 00 00 00 00 02 AA 83
		29 01 00 00 00 00 02 AB 03
		29 01 00 00 00 00 02 AC 94
		29 01 00 00 00 00 02 AD 03
		29 01 00 00 00 00 02 AE A3
		29 01 00 00 00 00 02 AF 03
		29 01 00 00 00 00 02 B0 AD
		29 01 00 00 00 00 02 B1 03
		29 01 00 00 00 00 02 B2 CC
		29 01 00 00 00 00 02 B3 00
		29 01 00 00 00 00 02 B4 18
		29 01 00 00 00 00 02 B5 00
		29 01 00 00 00 00 02 B6 38
		29 01 00 00 00 00 02 B7 00
		29 01 00 00 00 00 02 B8 65
		29 01 00 00 00 00 02 B9 00
		29 01 00 00 00 00 02 BA 84
		29 01 00 00 00 00 02 BB 00
		29 01 00 00 00 00 02 BC 9B
		29 01 00 00 00 00 02 BD 00
		29 01 00 00 00 00 02 BE AF
		29 01 00 00 00 00 02 BF 00
		29 01 00 00 00 00 02 C0 C1
		29 01 00 00 00 00 02 C1 00
		29 01 00 00 00 00 02 C2 D2
		29 01 00 00 00 00 02 C3 00
		29 01 00 00 00 00 02 C4 DF
		29 01 00 00 00 00 02 C5 01
		29 01 00 00 00 00 02 C6 11
		29 01 00 00 00 00 02 C7 01
		29 01 00 00 00 00 02 C8 38
		29 01 00 00 00 00 02 C9 01
		29 01 00 00 00 00 02 CA 76
		29 01 00 00 00 00 02 CB 01
		29 01 00 00 00 00 02 CC A7
		29 01 00 00 00 00 02 CD 01
		29 01 00 00 00 00 02 CE F3
		29 01 00 00 00 00 02 CF 02
		29 01 00 00 00 00 02 D0 2F
		29 01 00 00 00 00 02 D1 02
		29 01 00 00 00 00 02 D2 30
		29 01 00 00 00 00 02 D3 02
		29 01 00 00 00 00 02 D4 66
		29 01 00 00 00 00 02 D5 02
		29 01 00 00 00 00 02 D6 A0
		29 01 00 00 00 00 02 D7 02
		29 01 00 00 00 00 02 D8 C5
		29 01 00 00 00 00 02 D9 02
		29 01 00 00 00 00 02 DA F8
		29 01 00 00 00 00 02 DB 03
		29 01 00 00 00 00 02 DC 1B
		29 01 00 00 00 00 02 DD 03
		29 01 00 00 00 00 02 DE 46
		29 01 00 00 00 00 02 DF 03
		29 01 00 00 00 00 02 E0 52
		29 01 00 00 00 00 02 E1 03
		29 01 00 00 00 00 02 E2 62
		29 01 00 00 00 00 02 E3 03
		29 01 00 00 00 00 02 E4 71
		29 01 00 00 00 00 02 E5 03
		29 01 00 00 00 00 02 E6 83
		29 01 00 00 00 00 02 E7 03
		29 01 00 00 00 00 02 E8 94
		29 01 00 00 00 00 02 E9 03
		29 01 00 00 00 00 02 EA A3
		29 01 00 00 00 00 02 EB 03
		29 01 00 00 00 00 02 EC AD
		29 01 00 00 00 00 02 ED 03
		29 01 00 00 00 00 02 EE CC
		29 01 00 00 00 00 02 EF 00
		29 01 00 00 00 00 02 F0 18
		29 01 00 00 00 00 02 F1 00
		29 01 00 00 00 00 02 F2 38
		29 01 00 00 00 00 02 F3 00
		29 01 00 00 00 00 02 F4 65
		29 01 00 00 00 00 02 F5 00
		29 01 00 00 00 00 02 F6 84
		29 01 00 00 00 00 02 F7 00
		29 01 00 00 00 00 02 F8 9B
		29 01 00 00 00 00 02 F9 00
		29 01 00 00 00 00 02 FA AF
		29 01 00 00 00 00 02 FB 01

		29 01 00 00 00 00 02 FF 02
		29 01 00 00 00 00 02 00 00
		29 01 00 00 00 00 02 01 C1
		29 01 00 00 00 00 02 02 00
		29 01 00 00 00 00 02 03 D2
		29 01 00 00 00 00 02 04 00
		29 01 00 00 00 00 02 05 DF
		29 01 00 00 00 00 02 06 01
		29 01 00 00 00 00 02 07 11
		29 01 00 00 00 00 02 08 01
		29 01 00 00 00 00 02 09 38
		29 01 00 00 00 00 02 0A 01
		29 01 00 00 00 00 02 0B 76
		29 01 00 00 00 00 02 0C 01
		29 01 00 00 00 00 02 0D A7
		29 01 00 00 00 00 02 0E 01
		29 01 00 00 00 00 02 0F F3
		29 01 00 00 00 00 02 10 02
		29 01 00 00 00 00 02 11 2F
		29 01 00 00 00 00 02 12 02
		29 01 00 00 00 00 02 13 30
		29 01 00 00 00 00 02 14 02
		29 01 00 00 00 00 02 15 66
		29 01 00 00 00 00 02 16 02
		29 01 00 00 00 00 02 17 A0
		29 01 00 00 00 00 02 18 02
		29 01 00 00 00 00 02 19 C5
		29 01 00 00 00 00 02 1A 02
		29 01 00 00 00 00 02 1B F8
		29 01 00 00 00 00 02 1C 03
		29 01 00 00 00 00 02 1D 1B
		29 01 00 00 00 00 02 1E 03
		29 01 00 00 00 00 02 1F 46
		29 01 00 00 00 00 02 20 03
		29 01 00 00 00 00 02 21 52
		29 01 00 00 00 00 02 22 03
		29 01 00 00 00 00 02 23 62
		29 01 00 00 00 00 02 24 03
		29 01 00 00 00 00 02 25 71
		29 01 00 00 00 00 02 26 03
		29 01 00 00 00 00 02 27 83
		29 01 00 00 00 00 02 28 03
		29 01 00 00 00 00 02 29 94
		29 01 00 00 00 00 02 2A 03
		29 01 00 00 00 00 02 2B A3
		29 01 00 00 00 00 02 2D 03
		29 01 00 00 00 00 02 2F AD
		29 01 00 00 00 00 02 30 03
		29 01 00 00 00 00 02 31 CC
		29 01 00 00 00 00 02 32 00
		29 01 00 00 00 00 02 33 18
		29 01 00 00 00 00 02 34 00
		29 01 00 00 00 00 02 35 38
		29 01 00 00 00 00 02 36 00
		29 01 00 00 00 00 02 37 65
		29 01 00 00 00 00 02 38 00
		29 01 00 00 00 00 02 39 84
		29 01 00 00 00 00 02 3A 00
		29 01 00 00 00 00 02 3B 9B
		29 01 00 00 00 00 02 3D 00
		29 01 00 00 00 00 02 3F AF
		29 01 00 00 00 00 02 40 00
		29 01 00 00 00 00 02 41 C1
		29 01 00 00 00 00 02 42 00
		29 01 00 00 00 00 02 43 D2
		29 01 00 00 00 00 02 44 00
		29 01 00 00 00 00 02 45 DF
		29 01 00 00 00 00 02 46 01
		29 01 00 00 00 00 02 47 11
		29 01 00 00 00 00 02 48 01
		29 01 00 00 00 00 02 49 38
		29 01 00 00 00 00 02 4A 01
		29 01 00 00 00 00 02 4B 76
		29 01 00 00 00 00 02 4C 01
		29 01 00 00 00 00 02 4D A7
		29 01 00 00 00 00 02 4E 01
		29 01 00 00 00 00 02 4F F3
		29 01 00 00 00 00 02 50 02
		29 01 00 00 00 00 02 51 2F
		29 01 00 00 00 00 02 52 02
		29 01 00 00 00 00 02 53 30
		29 01 00 00 00 00 02 54 02
		29 01 00 00 00 00 02 55 66
		29 01 00 00 00 00 02 56 02
		29 01 00 00 00 00 02 58 A0
		29 01 00 00 00 00 02 59 02
		29 01 00 00 00 00 02 5A C5
		29 01 00 00 00 00 02 5B 02
		29 01 00 00 00 00 02 5C F8
		29 01 00 00 00 00 02 5D 03
		29 01 00 00 00 00 02 5E 1B
		29 01 00 00 00 00 02 5F 03
		29 01 00 00 00 00 02 60 46
		29 01 00 00 00 00 02 61 03
		29 01 00 00 00 00 02 62 52
		29 01 00 00 00 00 02 63 03
		29 01 00 00 00 00 02 64 62
		29 01 00 00 00 00 02 65 03
		29 01 00 00 00 00 02 66 71
		29 01 00 00 00 00 02 67 03
		29 01 00 00 00 00 02 68 83
		29 01 00 00 00 00 02 69 03
		29 01 00 00 00 00 02 6A 94
		29 01 00 00 00 00 02 6B 03
		29 01 00 00 00 00 02 6C A3
		29 01 00 00 00 00 02 6D 03
		29 01 00 00 00 00 02 6E AD
		29 01 00 00 00 00 02 6F 03
		29 01 00 00 00 00 02 70 CC
		29 01 00 00 00 00 02 71 00
		29 01 00 00 00 00 02 72 18
		29 01 00 00 00 00 02 73 00
		29 01 00 00 00 00 02 74 38
		29 01 00 00 00 00 02 75 00
		29 01 00 00 00 00 02 76 65
		29 01 00 00 00 00 02 77 00
		29 01 00 00 00 00 02 78 84
		29 01 00 00 00 00 02 79 00
		29 01 00 00 00 00 02 7A 9B
		29 01 00 00 00 00 02 7B 00
		29 01 00 00 00 00 02 7C AF
		29 01 00 00 00 00 02 7D 00
		29 01 00 00 00 00 02 7E C1
		29 01 00 00 00 00 02 7F 00
		29 01 00 00 00 00 02 80 D2
		29 01 00 00 00 00 02 81 00
		29 01 00 00 00 00 02 82 DF
		29 01 00 00 00 00 02 83 01
		29 01 00 00 00 00 02 84 11
		29 01 00 00 00 00 02 85 01
		29 01 00 00 00 00 02 86 38
		29 01 00 00 00 00 02 87 01
		29 01 00 00 00 00 02 88 76
		29 01 00 00 00 00 02 89 01
		29 01 00 00 00 00 02 8A A7
		29 01 00 00 00 00 02 8B 01
		29 01 00 00 00 00 02 8C F3
		29 01 00 00 00 00 02 8D 02
		29 01 00 00 00 00 02 8E 2F
		29 01 00 00 00 00 02 8F 02
		29 01 00 00 00 00 02 90 30
		29 01 00 00 00 00 02 91 02
		29 01 00 00 00 00 02 92 66
		29 01 00 00 00 00 02 93 02
		29 01 00 00 00 00 02 94 A0
		29 01 00 00 00 00 02 95 02
		29 01 00 00 00 00 02 96 C5
		29 01 00 00 00 00 02 97 02
		29 01 00 00 00 00 02 98 F8
		29 01 00 00 00 00 02 99 03
		29 01 00 00 00 00 02 9A 1B
		29 01 00 00 00 00 02 9B 03
		29 01 00 00 00 00 02 9C 46
		29 01 00 00 00 00 02 9D 03
		29 01 00 00 00 00 02 9E 52
		29 01 00 00 00 00 02 9F 03
		29 01 00 00 00 00 02 A0 62
		29 01 00 00 00 00 02 A2 03
		29 01 00 00 00 00 02 A3 71
		29 01 00 00 00 00 02 A4 03
		29 01 00 00 00 00 02 A5 83
		29 01 00 00 00 00 02 A6 03
		29 01 00 00 00 00 02 A7 94
		29 01 00 00 00 00 02 A9 03
		29 01 00 00 00 00 02 AA A3
		29 01 00 00 00 00 02 AB 03
		29 01 00 00 00 00 02 AC AD
		29 01 00 00 00 00 02 AD 03
		29 01 00 00 00 00 02 AE CC
		29 01 00 00 00 00 02 AF 00
		29 01 00 00 00 00 02 B0 18
		29 01 00 00 00 00 02 B1 00
		29 01 00 00 00 00 02 B2 38
		29 01 00 00 00 00 02 B3 00
		29 01 00 00 00 00 02 B4 65
		29 01 00 00 00 00 02 B5 00
		29 01 00 00 00 00 02 B6 84
		29 01 00 00 00 00 02 B7 00
		29 01 00 00 00 00 02 B8 9B
		29 01 00 00 00 00 02 B9 00
		29 01 00 00 00 00 02 BA AF
		29 01 00 00 00 00 02 BB 00
		29 01 00 00 00 00 02 BC C1
		29 01 00 00 00 00 02 BD 00
		29 01 00 00 00 00 02 BE D2
		29 01 00 00 00 00 02 BF 00
		29 01 00 00 00 00 02 C0 DF
		29 01 00 00 00 00 02 C1 01
		29 01 00 00 00 00 02 C2 11
		29 01 00 00 00 00 02 C3 01
		29 01 00 00 00 00 02 C4 38
		29 01 00 00 00 00 02 C5 01
		29 01 00 00 00 00 02 C6 76
		29 01 00 00 00 00 02 C7 01
		29 01 00 00 00 00 02 C8 A7
		29 01 00 00 00 00 02 C9 01
		29 01 00 00 00 00 02 CA F3
		29 01 00 00 00 00 02 CB 02
		29 01 00 00 00 00 02 CC 2F
		29 01 00 00 00 00 02 CD 02
		29 01 00 00 00 00 02 CE 30
		29 01 00 00 00 00 02 CF 02
		29 01 00 00 00 00 02 D0 66
		29 01 00 00 00 00 02 D1 02
		29 01 00 00 00 00 02 D2 A0
		29 01 00 00 00 00 02 D3 02
		29 01 00 00 00 00 02 D4 C5
		29 01 00 00 00 00 02 D5 02
		29 01 00 00 00 00 02 D6 F8
		29 01 00 00 00 00 02 D7 03
		29 01 00 00 00 00 02 D8 1B
		29 01 00 00 00 00 02 D9 03
		29 01 00 00 00 00 02 DA 46
		29 01 00 00 00 00 02 DB 03
		29 01 00 00 00 00 02 DC 52
		29 01 00 00 00 00 02 DD 03
		29 01 00 00 00 00 02 DE 62
		29 01 00 00 00 00 02 DF 03
		29 01 00 00 00 00 02 E0 71
		29 01 00 00 00 00 02 E1 03
		29 01 00 00 00 00 02 E2 83
		29 01 00 00 00 00 02 E3 03
		29 01 00 00 00 00 02 E4 94
		29 01 00 00 00 00 02 E5 03
		29 01 00 00 00 00 02 E6 A3
		29 01 00 00 00 00 02 E7 03
		29 01 00 00 00 00 02 E8 AD
		29 01 00 00 00 00 02 E9 03
		29 01 00 00 00 00 02 EA CC
		29 01 00 00 00 00 02 FB 01  
			 
		//CMD1           
		29 01 00 00 00 00 02 FF 00 
		29 01 00 00 00 00 02 D3 06
		29 01 00 00 00 00 02 D4 04
		29 01 00 00 00 00 02 35 00
		
		39 01 00 00 00 00 02 51 00 
    	       39 01 00 00 00 00 02 53 2C 
    	       39 01 00 00 00 00 02 55 01 
    	       
		29 01 00 00 78 00 02 11 00
		29 01 00 00 14 00 02 29 00];
		qcom,mdss-dsi-off-command = [05 01 00 00 32 00 02 28 00
					05 01 00 00 78 00 02 10 00];
		qcom,mdss-dsi-on-command-state = "dsi_lp_mode";
		qcom,mdss-dsi-off-command-state = "dsi_hs_mode";
		qcom,mdss-dsi-h-sync-pulse = <1>;
		qcom,mdss-dsi-traffic-mode = "burst_mode";
		qcom,mdss-dsi-bllp-eof-power-mode;
		qcom,mdss-dsi-bllp-power-mode;
		qcom,mdss-dsi-lane-0-state;
		qcom,mdss-dsi-lane-1-state;
		qcom,mdss-dsi-lane-2-state;
		qcom,mdss-dsi-lane-3-state;
		qcom,mdss-dsi-panel-timings = [D6 32 22 00 62 66 26 36 28 03 04 00];
		qcom,mdss-dsi-t-clk-post = <0x3>;
		qcom,mdss-dsi-t-clk-pre = <0x28>;
		qcom,mdss-dsi-bl-min-level = <1>;
		qcom,mdss-dsi-bl-max-level = <255>;
		qcom,mdss-dsi-dma-trigger = "trigger_sw";
		qcom,mdss-dsi-mdp-trigger = "none";
		qcom,mdss-dsi-bl-pmic-control-type = "bl_ctrl_dcs";
		qcom,mdss-dsi-reset-sequence = <1 5>, <0 5>, <1 5>, <0 5>, <1 20>;
		qcom,mdss-pan-physical-width-dimension = <68>;
		qcom,mdss-pan-physical-height-dimension = <121>;
	};
};
