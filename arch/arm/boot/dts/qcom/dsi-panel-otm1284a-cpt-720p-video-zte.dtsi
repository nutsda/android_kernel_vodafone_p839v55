/* Copyright (c) 2014, The Linux Foundation. All rights reserved.
 *
 * This program is free software; you can redistribute it and/or modify
 * it under the terms of the GNU General Public License version 2 and
 * only version 2 as published by the Free Software Foundation.
 *
 * This program is distributed in the hope that it will be useful,
 * but WITHOUT ANY WARRANTY; without even the implied warranty of
 * MERCHANTABILITY or FITNESS FOR A PARTICULAR PURPOSE.  See the
 * GNU General Public License for more details.
 */

/*---------------------------------------------------------------------------
 * This file is autogenerated file using gcdb parser. Please do not edit it.
 * Update input XML file to add a new entry or update variable in this file
 * VERSION = "1.0"
 *---------------------------------------------------------------------------*/
&mdss_mdp {
	dsi_otm1284a_cpt_720p_video: qcom,mdss_dsi_otm1284a_cpt_720p_video {
		qcom,mdss-dsi-panel-name = "otm1284a cpt 720p video mode dsi panel";
		zfg,lcd-proc-panel-name = "zfgLEAD(otm1284a+cpt)_720*1280-5.0Inch";
		zfg,lcd-product = <800>;
		qcom,cont-splash-enabled;
        qcom,mdss-dsi-panel-controller = <&mdss_dsi0>;
		qcom,mdss-dsi-panel-type = "dsi_video_mode";
		qcom,mdss-dsi-panel-destination = "display_1";
		qcom,mdss-dsi-panel-framerate = <60>;
		qcom,mdss-dsi-virtual-channel-id = <0>;
		qcom,mdss-dsi-stream = <0>;
		qcom,mdss-dsi-panel-width = <720>;
		qcom,mdss-dsi-panel-height = <1280>;
		qcom,mdss-dsi-h-front-porch = <168>;
		qcom,mdss-dsi-h-back-porch = <168>;
		qcom,mdss-dsi-h-pulse-width = <6>;
		qcom,mdss-dsi-h-sync-skew = <0>;
		qcom,mdss-dsi-v-back-porch = <16>;
		qcom,mdss-dsi-v-front-porch = <16>;
		qcom,mdss-dsi-v-pulse-width = <2>;
		qcom,mdss-dsi-h-left-border = <0>;
		qcom,mdss-dsi-h-right-border = <0>;
		qcom,mdss-dsi-v-top-border = <0>;
		qcom,mdss-dsi-v-bottom-border = <0>;
		qcom,mdss-dsi-bpp = <24>;
		qcom,mdss-dsi-color-order = "rgb_swap_rgb";
		qcom,mdss-dsi-underflow-color = <0xff>;
		qcom,mdss-dsi-border-color = <0>;
		qcom,mdss-dsi-on-command = [
		    29 01 00 00 00 00 02 00 00
29 01 00 00 00 00 04 ff 12 84 01	//EXTC=1
29 01 00 00 00 00 02 00 80	            //Orise mode enable
29 01 00 00 00 00 03 ff 12 84

29 01 00 00 00 00 02 00 92	            //Orise mode enable
29 01 00 00 00 00 03 ff 30 02
//-------------------- panel setting --------------------//
29 01 00 00 00 00 02 00 80             //TCON Setting
29 01 00 00 00 00 0a c0 00 64 00 10 10 00 64 10 10

29 01 00 00 00 00 02 00 90             //Panel Timing Setting
29 01 00 00 00 00 07 c0 00 5c 00 01 00 04

29 01 00 00 00 00 02 00 b3             //Interval Scan Frame: 0 frame, column inversion
29 01 00 00 00 00 03 c0 00 55

29 01 00 00 00 00 02 00 81             //frame rate:60Hz
29 01 00 00 00 00 02 c1 55
29 01 00 00 00 00 02 00 b1             //pwm 22.78khz
29 01 00 00 00 00 02 c6 02

29 01 00 00 00 00 02 00 b4             //pwm 22.78khz
29 01 00 00 00 00 02 c6 10

//-------------------- power setting --------------------//
29 01 00 00 00 00 02 00 a0             //dcdc setting
29 01 00 00 00 00 0f c4 05 10 06 02 05 15 10 05 10 07 02 05 15 10

29 01 00 00 00 00 02 00 b0             //clamp voltage setting
29 01 00 00 00 00 03 c4 00 00

29 01 00 00 00 00 02 00 91             //VGH=15V, VGL=-10V, pump ratio:VGH=6x, VGL=-5x
29 01 00 00 00 00 03 c5 46 42

29 01 00 00 00 00 02 00 00             //GVDD=4.87V, NGVDD=-4.87V
29 01 00 00 00 00 03 d8 bc bc

29 01 00 00 00 00 02 00 00            
29 01 00 00 00 00 02 d9 8d

29 01 00 00 00 00 02 00 b3             //VDD_18V=1.7V, LVDSVDD=1.6V
29 01 00 00 00 00 02 c5 84

29 01 00 00 00 00 02 00 bb             //LVD voltage level setting
29 01 00 00 00 00 02 c5 8a

29 01 00 00 00 00 02 00 82		// chopper
29 01 00 00 00 00 02 C4 0a 

29 01 00 00 00 00 02 00 c6		// debounce
29 01 00 00 00 00 02 B0 03 

29 01 00 00 00 00 02 00 c2             //precharge disable
29 01 00 00 00 00 02 f5 40

29 01 00 00 00 00 02 00 c3             //sample hold gvdd
29 01 00 00 00 00 02 f5 85

29 01 00 00 00 00 02 00 87             //en op
29 01 00 00 00 00 02 c4 18

//-------------------- control setting --------------------//
29 01 00 00 00 00 02 00 00             //ID1
29 01 00 00 00 00 02 d0 40

29 01 00 00 00 00 02 00 00             //ID2, ID3
29 01 00 00 00 00 03 d1 00 00

//-------------------- panel timing state control --------------------//
29 01 00 00 00 00 02 00 80             //panel timing state control
29 01 00 00 00 00 0c cb 00 00 00 00 00 00 00 00 00 00 00

29 01 00 00 00 00 02 00 90             //panel timing state control
29 01 00 00 00 00 10 cb 00 00 00 00 00 00 00 00 00 00 00 00 00 00 00

29 01 00 00 00 00 02 00 a0             //panel timing state control
29 01 00 00 00 00 10 cb 00 00 00 00 00 00 00 00 00 00 00 00 00 00 00

29 01 00 00 00 00 02 00 b0             //panel timing state control
29 01 00 00 00 00 10 cb 00 00 00 00 00 00 00 00 00 00 00 00 00 00 00

29 01 00 00 00 00 02 00 c0             //panel timing state control
29 01 00 00 00 00 10 cb 05 05 05 05 05 00 00 00 00 00 00 00 00 00 00

29 01 00 00 00 00 02 00 d0             //panel timing state control
29 01 00 00 00 00 10 cb ff ff ff 00 05 05 05 05 05 05 05 05 00 00 00

29 01 00 00 00 00 02 00 e0             //panel timing state control
29 01 00 00 00 00 0f cb 00 00 00 00 00 00 00 ff ff ff 00 05 05 05

29 01 00 00 00 00 02 00 f0             //panel timing state control
29 01 00 00 00 00 0c cb ff ff ff ff ff ff ff ff ff ff ff

//-------------------- panel pad mapping control --------------------//
29 01 00 00 00 00 02 00 80             //panel pad mapping control
29 01 00 00 00 00 10 cc 02 0a 0c 0e 10 00 00 00 00 00 00 00 00 00 00

29 01 00 00 00 00 02 00 90             //panel pad mapping control
29 01 00 00 00 00 10 cc 00 00 00 00 2e 2d 06 01 09 0b 0d 0f 00 00 00

29 01 00 00 00 00 02 00 a0             //panel pad mapping control
29 01 00 00 00 00 0f cc 00 00 00 00 00 00 00 00 00 00 00 2e 2d 05

29 01 00 00 00 00 02 00 b0             //panel pad mapping control
29 01 00 00 00 00 10 cc 05 0f 0d 0b 09 00 00 00 00 00 00 00 00 00 00

29 01 00 00 00 00 02 00 c0             //panel pad mapping control
29 01 00 00 00 00 10 cc 00 00 00 00 2d 2e 01 06 10 0e 0c 0a 00 00 00

29 01 00 00 00 00 02 00 d0             //panel pad mapping control
29 01 00 00 00 00 0f cc 00 00 00 00 00 00 00 00 00 00 00 2d 2e 02

//-------------------- panel timing setting --------------------//
29 01 00 00 00 00 02 00 80             //panel VST setting
29 01 00 00 00 00 0d ce 87 03 10 86 03 10 00 00 00 00 00 00

29 01 00 00 00 00 02 00 90             //panel VEND setting
29 01 00 00 00 00 0f ce 35 01 10 35 02 10 00 00 00 00 00 00 00 00

29 01 00 00 00 00 02 00 a0             //panel CLKA1/2 setting
29 01 00 00 00 00 0f ce 38 03 04 f8 00 10 00 38 02 04 f9 00 10 00

29 01 00 00 00 00 02 00 b0             //panel CLKA3/4 setting
29 01 00 00 00 00 0f ce 38 01 04 fa 00 10 00 38 00 04 fb 00 10 00

29 01 00 00 00 00 02 00 c0             //panel CLKb1/2 setting
29 01 00 00 00 00 0f ce 30 00 04 fc 00 10 00 30 01 04 fd 00 10 00

29 01 00 00 00 00 02 00 d0             //panel CLKb3/4 setting
29 01 00 00 00 00 0f ce 30 02 04 fe 00 10 00 30 03 04 ff 00 10 00

29 01 00 00 00 00 02 00 80             //panel CLKc1/2 setting
29 01 00 00 00 00 0f cf 00 00 00 00 00 00 00 00 00 00 00 00 00 00

29 01 00 00 00 00 02 00 90             //panel CLKc3/4 setting
29 01 00 00 00 00 0f cf 00 00 00 00 00 00 00 00 00 00 00 00 00 00

29 01 00 00 00 00 02 00 a0             //panel CLKd1/2 setting
29 01 00 00 00 00 0f cf 00 00 00 00 00 00 00 00 00 00 00 00 00 00

29 01 00 00 00 00 02 00 b0             //panel CLKd3/4 setting
29 01 00 00 00 00 0f cf 00 00 00 00 00 00 00 00 00 00 00 00 00 00

29 01 00 00 00 00 02 00 c0             //panel ECLK setting
29 01 00 00 00 00 0c cf 01 01 20 20 00 00 01 81 00 03 08 //gate pre. ena.

29 01 00 00 00 00 02 00 b5             //TCON_GOA_OUT Setting
29 01 00 00 00 00 07 c5 3f ff ff 3f ff ff

//-------------------- for Power IC --------------------//
29 01 00 00 00 00 02 00 90             //Mode-3
29 01 00 00 00 00 05 f5 02 11 02 15

29 01 00 00 00 00 02 00 90             //2xVPNL
29 01 00 00 00 00 02 c5 50

29 01 00 00 00 00 02 00 94             //Freq.
29 01 00 00 00 00 02 c5 66

//------------------VGLO1/O2 disable----------------
29 01 00 00 00 00 02 00 b2             //VGLO1
29 01 00 00 00 00 03 f5 00 00

29 01 00 00 00 00 02 00 b4             //VGLO1_S
29 01 00 00 00 00 03 f5 00 00

29 01 00 00 00 00 02 00 b6             //VGLO2
29 01 00 00 00 00 03 f5 00 00

29 01 00 00 00 00 02 00 b8             //VGLO2_S
29 01 00 00 00 00 03 f5 00 00

29 01 00 00 00 00 02 00 94             //VCL pump dis
29 01 00 00 00 00 03 f5 00 00

29 01 00 00 00 00 02 00 d2             //VCL reg. en
29 01 00 00 00 00 03 f5 06 15

29 01 00 00 00 00 02 00 b4             //VGLO1/2 Pull low setting
29 01 00 00 00 00 02 c5 cc				//d[7] vglo1 d[6] vglo2 => 0: pull vss, 1: pull vgl

//-------------------- Gamma --------------------//
29 01 00 00 00 00 02 00 00                                                                                    ////
29 01 00 00 00 00 15 E1 00 11 1e 2b 3b 49 4c 7a 6e 8b 75 5d 6c 47 42 33 25 16 09 00
							
29 01 00 00 00 00 02 00 00
29 01 00 00 00 00 15 E2 00 11 1e 2b 3b 49 4c 7a 6e 8b 73 5b 6c 42 42 33 25 16 09 00

// ***********************CELEVER COLOR SETTING FOR CE ****************************************//
	29 01 00 00 00 00 02 00 A0
	29 01 00 00 00 00 0d D6 01 0d 01 0d 01 a6 01 a6 01 a6 01 a6

	29 01 00 00 00 00 02 00 B0
	29 01 00 00 00 00 0d D6 01 a6 01 a6 01 a6 01 a6 01 a6 01 a6

	29 01 00 00 00 00 02 00 C0
	29 01 00 00 00 00 0d D6 55 11 09 6f 11 6f 6f 11 6f 6f 11 6f

	29 01 00 00 00 00 02 00 D0
	29 01 00 00 00 00 07 D6 6f 11 6f 6f 11 6f

	29 01 00 00 00 00 02 00 E0
	29 01 00 00 00 00 0d D6 2b 11 37 37 11 37 37 11 37 37 11 37

	29 01 00 00 00 00 02 00 F0
	29 01 00 00 00 00 07 D6 37 11 37 37 11 37

//CE off
	29 01 00 00 00 00 02 00 00             
	29 01 00 00 00 00 02 81 80	//CE  low


    29 01 00 00 00 00 02 00 00             //Orise mode disable
    29 01 00 00 00 00 04 ff ff ff ff
			
			39 01 00 00 00 00 02 51  00 
	    	39 01 00 00 00 00 02 53  2c 
	    	39 01 00 00 00 00 02 55  01 	
			
			05 01 00 00 78 00 02 11 00 
            05 01 00 00 00 00 02 29 00 
		];
		qcom,mdss-dsi-off-command = [05 01 00 00 00 00 02 28 00
					05 01 00 00 78 00 02 10 00];
		qcom,mdss-dsi-on-command-state = "dsi_lp_mode";
		qcom,mdss-dsi-off-command-state = "dsi_hs_mode";
		//qcom,esd-check-enabled;
		//qcom,mdss-dsi-panel-status-check-mode = "bta_check";
		//qcom,mdss-dsi-panel-status-command = [06 01 00 01 05 00 02 0E 08];
		//qcom,mdss-dsi-panel-status-command-state = "dsi_lp_mode";
		//qcom,mdss-dsi-panel-status-check-mode = "reg_read";
		//qcom,mdss-dsi-panel-status-value = <0x80>;
		qcom,mdss-dsi-h-sync-pulse = <1>;
		qcom,mdss-dsi-traffic-mode = "non_burst_sync_event";
		qcom,mdss-dsi-lane-map = "lane_map_0123";
		qcom,mdss-dsi-bllp-eof-power-mode;
		qcom,mdss-dsi-bllp-power-mode;
		qcom,mdss-dsi-lane-0-state;
		qcom,mdss-dsi-lane-1-state;
		qcom,mdss-dsi-lane-2-state;
		qcom,mdss-dsi-lane-3-state;
		qcom,mdss-dsi-panel-timings = [7c 20 14 00 46 48 1a 22 18 03 04 00];
		qcom,mdss-dsi-t-clk-post = <0x04>;
		qcom,mdss-dsi-t-clk-pre = <0x27>;
		qcom,mdss-dsi-bl-min-level = <1>;
		qcom,mdss-dsi-bl-max-level = <255>;
		qcom,mdss-dsi-dma-trigger = <0x04>;
		qcom,mdss-dsi-mdp-trigger = <0x0>;
		qcom,mdss-dsi-bl-pmic-control-type = "bl_ctrl_dcs";
		/*qcom,mdss-dsi-bl-cmd-gpio = <&msmgpio 34 0>;*/
		qcom,mdss-dsi-reset-sequence = <1 20>, <0 20>, <1 20>;
		qcom,mdss-pan-physical-width-dimension = <64>;
		qcom,mdss-pan-physical-height-dimension = <113>;
	};
};
