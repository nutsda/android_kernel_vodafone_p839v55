## arch/arm/configs/msm_debug_defconfig
```kconfig
#recommended by QC Mingsen Xu++++
CONFIG_FORCE_PAGES=y
CONFIG_FREE_PAGES_RDONLY=y

CONFIG_DEBUG_MUTEXES=y
CONFIG_DEBUG_SPINLOCK=y

CONFIG_DEBUG_PAGEALLOC=y
CONFIG_DEBUG_LIST=y
CONFIG_PAGE_POISONING=y

CONFIG_DEBUG_VM=y
CONFIG_PANIC_ON_DATA_CORRUPTION=y
CONFIG_MSM_RTB=y

CONFIG_SLUB_DEBUG=y
CONFIG_SLUB_DEBUG_ON=y
#recommended by QC Mingsen Xu----

#added by zhouxin++++
CONFIG_MSM_FORCE_WDOG_BITE_ON_PANIC=y
CONFIG_SLUB_DEBUG_PANIC_ON=y
CONFIG_MSM_RTB_SEPARATE_CPUS=y
#added by zhouxin----
```

## arch/arm64/configs/msm_debug_defconfig
```kconfig
CONFIG_LOCALVERSION="-debug"
CONFIG_CGROUP_DEBUG=y
CONFIG_MODULE_SIG=y
CONFIG_MODULE_SIG_FORCE=y
CONFIG_MODULE_SIG_SHA512=y
CONFIG_CMA_SIZE_MBYTES=64
CONFIG_MSM_ADSPRPC=y
CONFIG_REGULATOR_TPS65132=y
CONFIG_MSM_QUSB_PHY=y
CONFIG_USB_BAM=y
CONFIG_PFT=y
CONFIG_CP_ACCESS64=y
CONFIG_MSM_SMD_DEBUG=y
CONFIG_MSM_DEBUG_LAR_UNLOCK=y
CONFIG_MSM_FORCE_WDOG_BITE_ON_PANIC=y
CONFIG_MSM_OCMEM_DEBUG=y
CONFIG_MSM_OCMEM_NONSECURE=y
CONFIG_MSM_TZ_LOG=y
CONFIG_LOCKUP_DETECTOR=y
CONFIG_BOOTPARAM_SOFTLOCKUP_PANIC=y
CONFIG_DEBUG_KMEMLEAK=y
CONFIG_DEBUG_KMEMLEAK_DEFAULT_OFF=y
CONFIG_DEBUG_SPINLOCK=y
CONFIG_DEBUG_MUTEXES=y
CONFIG_DEBUG_ATOMIC_SLEEP=y
CONFIG_DEBUG_STACK_USAGE=y
CONFIG_DEBUG_MEMORY_INIT=y
CONFIG_DEBUG_LIST=y
CONFIG_FAULT_INJECTION=y
CONFIG_FAIL_PAGE_ALLOC=y
CONFIG_FAULT_INJECTION_DEBUG_FS=y
CONFIG_FAULT_INJECTION_STACKTRACE_FILTER=y
CONFIG_MSM_RTB=y
CONFIG_MSM_RTB_SEPARATE_CPUS=y
CONFIG_DYNAMIC_DEBUG=y
CONFIG_PANIC_ON_DATA_CORRUPTION=y
```
